## board/leica/crocodile/Kconfig
```kconfig
if TARGET_CROCODILE

config SYS_BOARD
	default "crocodile"

config SYS_VENDOR
	default "leica"

config SYS_CONFIG_NAME
	default "crocodile"

config IMX_CONFIG
	default "board/freescale/crocodile/imximage-8mm-lpddr4.cfg"

endif
```
